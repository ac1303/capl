/*@!Encoding:65001*/
includes
{
  #include "struct\\DiagStruct.can"
  #include "struct\LoggingStruct.can"
//  #pragma library("osektp\\osek_tp.dll")
}

variables
{
}

long CreateCANConnection( WORD txId, WORD rxId)
{
  long handle;
  struct Diag d;
  handle = CanTpCreateConnection(0);          // normal mode
  CanTpSetTxIdentifier( handle, txId);
  CanTpSetRxIdentifier( handle, rxId);
  CanTpSetPadding(handle,0xAA);
  if(handle <= 0){
    Write("CreateCANConnection: 创建链接失败 handle = %d",handle);
  }else{
    CanTpFI_Enable(handle); //开启故障激活注入 可以使用所有CanTpFI开头的函数
    d.handle = handle;
    d.p2server = 50;
    d.p2_server = 5000;
    d.timeout = 200;
  }
  setDiagMap(d);
  return handle;
}
long CreateCANFDConnection(WORD txId, WORD rxId){
  long handle;
  handle = CreateCANConnection(txId,rxId);
 if(handle <= 0){
    logging("CreateCANFDConnection：创建连接失败 handle = ",handle);
 }
  CanTpSetMaxCANFDFrameLength( handle, 64);  // activate CAN FD
  CanTpSetBitRateSwitch( handle, 1);         // activate BRS
  return handle;
}
// =========================================================================发送和接收核心函数
void sendDiag(long diagHandle,byte data[]){
  sendDiag(diagHandle,data,elcount(data));
}
void sendDiag(long diagHandle,byte data[],long length){
  long count,CFCount,FCCount;
  count = 0;
  setDiagReqData(diagHandle,data,length);
  CanTpSendData(diagHandle, data, length);
  setDiagRespInd(diagHandle,Sending);
  while(getDiagRespInd(diagHandle) == Sending){
    testWaitForTimeout(1);
  }
  if(getDiagRespInd(diagHandle) == SendFail){
    return;
  }
  _waitResponse(diagHandle);
//  logging(debug,"sendDiag：诊断发送完成，当前状态是",getDiagRespInd(diagHandle));
}
int _waitResponse(long diagHandle){
  return _waitResponse(diagHandle,0);
}
int _waitResponse(long diagHandle,long count){
  long PendingCount;
  long PendingTime;
  while(getDiagRespInd(diagHandle) == WaitAnswer){
    if(count >= getDiagP2server(diagHandle)){
      setDiagRespInd(diagHandle,diagTimeout);
      return _waitResponse(diagHandle,count);
    }
    count++;
    testWaitForTimeout(1);
  }
  while(getDiagRespInd(diagHandle) == Pending){
    if(getDiagPendingCount(diagHandle) != PendingCount){
      PendingCount = getDiagPendingCount(diagHandle);
      PendingTime = 0;
    }
    if(PendingTime >= getDiagP2server(diagHandle)){
      write(" NRC 0x78 诊断响应超时!!!");
      setDiagRespInd(diagHandle,NoAnswer);
      return diagTimeout;
    }
    PendingTime++;
    testWaitForTimeout(1);
  }
  while(getDiagRespInd(diagHandle) == FlowControl){
    // 暂时不做处理
    write("_waitResponse：收到流控帧，但是没有做相关处理，我认为不应该执行到这里，");
  }
  // 处理timeout
  while(getDiagRespInd(diagHandle) == diagTimeout){
    if(count >= getDiagTimeout(diagHandle)){
      setDiagRespInd(diagHandle,NoAnswer);
      logging(warning,LOG_MESSAGE,"诊断无应答！！！");
      return NoAnswer;
    }
    count++;
    testWaitForTimeout(1);
  }
  if(getDiagRespInd(diagHandle) == OverFlow){
    return OverFlow;
  }
  if(count <= getDiagP2server(diagHandle)){
    logging(debug,LOG_MESSAGE,"诊断响应成功，响应时间为 ",count," ms");
    setDiagRespInd(diagHandle,Answer);
    return diagTimeoutButAnswered;
  }else{
    logging(error,LOG_MESSAGE,"诊断响应超时，响应时间为 ",count ," ms");
    setDiagRespInd(diagHandle,diagTimeoutButAnswered);
    return diagTimeoutButAnswered;
  }
  write("_waitResponse出现一个错误，等待响应时间为 count = %d，当前状态为 %d",count,getDiagRespInd(diagHandle));
  return NoAnswer;
}

long getDiagResp(long handle,byte buffer[]){
  if(getDiagRespInd(handle) == Answer){
    getDiagRespData(handle,buffer); 
    return getDiagRespLength(handle);
  }
//  if(getDiagRespInd(handle) == diagTimeoutButAnswered){ /需要打印响应超时时间，暂未保存
//    getDiagRespData(handle,buffer); 
//    return getDiagRespLength(handle);
//  }
  write("getDiagResp: 未收到应答！！");
  return 0;
}
//==========================================================================官方回调函数==========================================================
// 接收到响应数据回调函数
void CanTp_ReceptionInd( long connHandle, byte data[])
{
  if(data[0]==0x7f && data[2]==0x78){
    setDiagPendingCount(connHandle,getDiagPendingCount(connHandle)+1);
    setDiagRespInd(connHandle,Pending);
    return;
  }
  setDiagRespData(connHandle,data,elcount(data));
  setDiagRespInd(connHandle,Answer);
  logging(debug,LOG_MESSAGE, "收到应答报文， connHandle = ",connHandle);
  logging(debug,LOG_MESSAGE,"应答：",data,elCount(data));
}
// 发送成功回调函数
void CanTp_SendCon( long connHandle, dword count) //报文发送完成后调用这个函数
{
  byte buffer[4096];
  long len;
  getDiagReqData(connHandle,buffer);
  len=getDiagReqLength(connHandle);
  
  logging(debug,LOG_MESSAGE,"报文发送成功 connHandle = ",connHandle);
  logging(debug,LOG_MESSAGE,"请求：",buffer,len);
  setDiagRespInd(connHandle,WaitAnswer);
}
void CanTp_FirstFrameInd( long connHandle, dword length)
{
  write("Peer has started transfer of %d byte on connection %d"
  , length, connHandle);
}
void CanTp_PreSend( long handle, word msgDlc[], byte data[]){
//  if( 0x20 == (data[ CanTpFI_GetPCIOffset()] & 0xF0))
//    setDiagCFCount(handle,getDiagCFCount(handle)+1);
//  else if( 1 == CanTpFI_IsFlowControl())
//    setDiagFCCount(handle,getDiagFCCount(handle)+1);
}
void CanTp_ErrorInd( long connHandle, long a){
  char t[11]="11";
  switch(a){
    case 1:
      logging(warning,"CanTp_ErrorInd : 等待连续帧超时（Timeout waiting for Consecutive Frame.");
      break;
    case 2:
      logging(warning,"CanTp_ErrorInd : 等待流控帧超时（Timeout waiting for Flow Control Frame.） ");
      break;
    case 6:
      setDiagRespInd(connHandle,SendFail);
      logging(warning,"CanTp_ErrorInd : 报文发送超时（Timeout while trying to send a CAN message.） ");
      break;
    case 8:
      setDiagRespInd(connHandle,OverFlow);
      logging(warning,"CanTp_ErrorInd : 接收器缓冲区溢出，即接收到流控制溢出帧。（Receiver buffer overflow, i.e. a Flow Control Overflow Frame was received.） ");
      break;
    case 11:
      logging(warning,"CanTp_ErrorInd : 数据传输已从CAPL程序中明确中止。（The data transfer has been aborted explicitly from the CAPL program.） ");
      break;
    default:
      logging(warning,"CanTp_ErrorInd : 未知错误 错误标识 %d，参见Error Codes (OSEK TP)   Codes = ",a);
  }
  
  // TODO 这里需要针对这些异常进行处理
}
OSEKTL_ErrorInd(int error){
  switch(error){
    case 1:
      write("OSEKTL_ErrorInd : Timeout waiting for CF. ");
      break;
    default:
      write("OSEKTL_ErrorInd : 未知错误");
  }
  // TODO 这里需要针对这些异常进行处理
}
//===================================================快捷发送
int sendDiag36(long diagHandle,byte buffer[],long bufferlen,long buffertop){
  return sendDiag36(diagHandle,buffer,bufferlen,buffertop,130);
}
int sendDiag36(long diagHandle,byte buffer[],long bufferlen,long buffertop,dword segmentSize){
  int i = 1;
  byte q36[4096] = {0x36},respData[4096];
  i = 1;
  do{
    q36[1] = i;
    if(bufferlen - buffertop < segmentSize-2){
      memcpy_off(q36,2,buffer,buffertop,bufferlen - buffertop);
      sendDiag(diagHandle,q36,(bufferlen - buffertop)+2);
      buffertop = bufferlen;
    }else{
      memcpy_off(q36,2,buffer,buffertop,segmentSize-2);
      buffertop += segmentSize-2;
      sendDiag(diagHandle,q36,segmentSize);
    }
    if(i == 0xFF){
      i=0;
    }else{
      i++;
    }
    if(respData[0] != 0x76){
      logging(warning,LOG_MESSAGE,"36服务收到否定应答");
      return 0;
    }
  }while(buffertop < bufferlen);
  return 1;
}

void sendDiag1001(long diagHandle){
  byte q1001[2]={0x10,0x01};
  sendDiag(diagHandle,q1001);
  testWaitForTimeout(500);
}

void sendDiag1003(long diagHandle){
  byte request[2]={0x10,0x03};
  sendDiag(diagHandle,request);
  testWaitForTimeout(500);
}

void sendDiag1002(long diagHandle){
  byte q1002[2]={0x10,0x02};
  sendDiag(diagHandle,q1002);
  testWaitForTimeout(500);
}
void sendDiag1101(long diagHandle){
  byte q1101[2]={0x11,0x01};
  sendDiag(diagHandle,q1101);
  testWaitForTimeout(500);
}

void sendDiag14FFFFFF(long diagHandle){
  byte q14[4]={0x14,0xFF,0xFF,0xFF};
  sendDiag(diagHandle,q14);
}
void sendDiag190209(long diagHandle){
  byte q19[3]={0x19,0x02,0x09};
  sendDiag(diagHandle,q19);
}
void sendDiag22xxxx(long diagHandle,word did){
  byte q22[3] = {0x22};
  q22[1] = did >> 8;
  q22[2] = did & 0xFF;
  sendDiag(diagHandle,q22);
}

void sendDiag31010203(long diagHandle){
  byte q31010203[4] = {0x31,0x01,0x02,0x03};
  sendDiag(diagHandle,q31010203);
}

void sendDiag8502(long diagHandle){
  byte q8502[2] = {0x85, 0x02};
  sendDiag(diagHandle,q8502);
}

void sendDiag28xxxx(long diagHandle,word did){
  byte q28[3] = {0x28};
  q28[1] = did >> 8;
  q28[2] = did & 0xFF;
  sendDiag(diagHandle,q28);
}

void sendDiag27_seed(long diagHandle,byte lv){
  byte reqSeed[2] = {0x27};
  reqSeed[1]=lv;
  sendDiag(diagHandle,reqSeed);
}
void sendDiag27_key(long diagHandle,byte lv,dword unlockKey){
  byte reqKey[6] = {0x27};
  reqKey[1]=lv+1;
  reqKey[2]=unlockKey >> 24;
  reqKey[3]=unlockKey >> 16;
  reqKey[4]=unlockKey >> 8;
  reqKey[5]=unlockKey & 0xFF;
  sendDiag(diagHandle,reqKey);
}
void sendDiag27_key(long diagHandle,byte lv,byte unlockKey[]){
  byte reqKey[6] = {0x27};
  reqKey[1]=lv+1;
  memcpy_off(reqKey,2,unlockKey,0,4);
  sendDiag(diagHandle,reqKey);
}
void sendDiag27_UnlockSecurityLevel(long diagHandle,byte lv,char ecuName[]){
  
  byte reqSeed[2] = {0x27};
  byte reqKey[6] = {0x27};
  byte seedArray[4],keyArray[4]; 
  dword keyLen;
  byte respBuffer[20];
  
  diagSetTarget(ecuName);
  reqSeed[1]=lv;
  reqKey[1]=lv+1;
  
  sendDiag(diagHandle,reqSeed);
  AssertDiagTrue(diagHandle);
  getDiagRespData(diagHandle,respBuffer);
  memcpy_off(seedArray,0,respBuffer,2,4);
  diagGenerateKeyFromSeed(seedArray, elCount(seedArray) ,lv, ecuName, "", keyArray,  elCount(keyArray) , keyLen);
  memcpy_off(reqKey,2,keyArray,0,4);
  sendDiag(diagHandle,reqKey);
  AssertDiagTrue(diagHandle);
}

void sendDiag37(long diagHandle){
  byte q37[1]={0x37};
  sendDiag(diagHandle,q37);
}

void sendDiag3E00(long diagHandle){
  byte q3E[2]={0x3E,0x00};
  sendDiag(diagHandle,q3E);
}
void sendDiag31010202(long diagHandle,byte crcArray[],long crcArrayLen){
  byte q31010202[300] ={0x31,0x01,0x02,0x02};
  long len;
  memcpy_off(q31010202,4,crcArray,0,crcArrayLen);
  
  sendDiag(diagHandle,q31010202,4+crcArrayLen);
}
void sendDiag3101FF02(long diagHandle){
  byte q3101FF02[4]={0x31,0x01,0xFF,0x2};
  sendDiag(diagHandle,q3101FF02);
}
void sendDiag3101FF01(long diagHandle){
  byte q3101FF01[4]={0x31,0x01,0xFF,0x1};
  sendDiag(diagHandle,q3101FF01);
}

















// ==================================================断言===========================
void loggingMessage(long handle){
    long reqLength;// 发送的诊断服务数据
    byte reqData[4096];
    long respLength; // 诊断响应的实际长度
    byte respData[4096]; 
  
    reqLength = getDiagReqLength(handle);
    getDiagReqData(handle,reqData);
    respLength = getDiagRespLength(handle);
    getDiagRespData(handle,respData);
    logging(info,LOG_ASSERT,"请求报文：",reqData,reqLength);
    logging(info,LOG_ASSERT,"响应报文：",respData,respLength);
}
void AssertDiagTrue(long handle){
  long len;
  byte resp[1024], req[1024];
  if(!getDiagRespInd(handle)){
    logging(error,LOG_ASSERT,"响应异常！");
    loggingMessage(handle);
    return;
  }
  getDiagRespData(handle,resp);
  getDiagReqData(handle,req);
  len = getDiagRespLength(handle);
  
  if(req[0] + 0x40 != resp[0]){
    logging(error,LOG_ASSERT, "未收到肯定应答！");
  }else{
    logging(info,LOG_ASSERT,"预期肯定应答，实际肯定应答");
  }
  loggingMessage(handle);
}
void AssertDiagFalse(long handle){
  long len;
  byte resp[1024], req[1024];
  if(!getDiagRespInd(handle)){
    logging(error,LOG_ASSERT,"响应异常！");
    loggingMessage(handle);
    return;
  }
  getDiagRespData(handle,resp);
  getDiagReqData(handle,req);
  len = getDiagRespLength(handle);
  
  if(req[0] != 0x7F){
    logging(error,LOG_ASSERT, "未收到否定应答");
  }else{
    logging(info,LOG_ASSERT,"预期接收到肯定应答");
  }
  loggingMessage(handle);
}
void AssertDiagNoResponse(long handle){
  if(getDiagRespInd(handle) != NoAnswer){
    logging(error,LOG_ASSERT, "期待无响应，实际状态为 getDiagRespInd(handle) =  ",getDiagRespInd(handle));
  }
    logging(info,LOG_ASSERT,"期待无响应，实际无响应");
}
