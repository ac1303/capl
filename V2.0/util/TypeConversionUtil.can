/*@!Encoding:65001*/

includes{

}

variables{

}
long max(long a,long b){
  return a>b ? a:b;
}
long min(long a,long b){
    return a<b ? a:b;
}
void byteArrayToCharString(byte byteArray[], char charString[]) {
  byteArrayToCharString(byteArray,elCount(byteArray),charString);
}
void byteArrayToCharString(byte byteArray[], long length, char charString[]) {
    long charIndex,i;
    char highNibble,lowNibble;
    charIndex = 0; 
    for (i = 0; i < min(length,(elCount(charString)-1)/2); i+=1) {
      highNibble = byteArray[i] >> 4 & 0x0F;
      lowNibble = byteArray[i] & 0x0F;
      if(highNibble < 10){
        charString[charIndex++] = highNibble + 48;
      }else{
        charString[charIndex++] = highNibble + 55;
      }
      if(lowNibble < 10){
        charString[charIndex++] = lowNibble + 48;
      }else{
        charString[charIndex++] = lowNibble + 55;
      }
//      write("i = %d byteArray[i] =%x highNibble = %d lowNibble = %d",i,byteArray[i],highNibble,lowNibble);
    }
    charString[charIndex] = '\0'; 
}
